/*
 * Copyright (c) 2024 The ZMK Contributors
 *
 * SPDX-License-Identifier: MIT
 */

#include <behaviors.dtsi>
#include <dt-bindings/zmk/keys.h>
#include <dt-bindings/zmk/bt.h>
#include <dt-bindings/zmk/outputs.h>

#define _BT_SEL_KEYS_                                                        \
      &bt BT_SEL 0 &bt BT_SEL 1 &bt BT_SEL 2 &bt BT_SEL 3 &bt BT_CLR

// Include urob helpers
#include "zmk-helpers/helper.h"
#include "klor.h"

// Define layer names
#define BAS  0
#define QWE  1
#define NAV  2
#define NUM  3
#define WIN  4
#define FUN  5
#define MOU  6

#define XXX &none
#define ___ &trans

/* Global defaults */

#define QUICK_TAP_MS 175

&sk {
  release-after-ms = <900>;
  quick-release;
};

&sl { // Allow sticky mods to chord across sticky layers.
  ignore-modifiers;
};

&lt {
  flavor = "balanced";
  tapping-term-ms = <200>;
  quick-tap-ms = <QUICK_TAP_MS>;
};

/* Homerow mods */

#define KEYS_L LT0 LT1 LT2 LT3 LT4 LM0 LM1 LM2 LM3 LM4 LM5 LB0 LB1 LB2 LB3 LB4 LB5
#define KEYS_R RT0 RT1 RT2 RT3 RT4 RM0 RM1 RM2 RM3 RM4 RM5 RB0 RB1 RB2 RB3 RB4 RB5
#define THUMBS LH3 LH2 LH1 LH0 RH0 RH1 RH2 RH3

#define MAKE_HRM(NAME, HOLD, TAP, TRIGGER_POS)                                 \
  ZMK_HOLD_TAP(NAME, bindings = <HOLD>, <TAP>; flavor = "balanced";            \
               tapping-term-ms = <280>; quick-tap-ms = <QUICK_TAP_MS>;         \
               require-prior-idle-ms = <150>; hold-trigger-on-release;         \
               hold-trigger-key-positions = <TRIGGER_POS>;)

MAKE_HRM(hml, &kp, &kp, KEYS_R THUMBS) // Left-hand HRMs.
MAKE_HRM(hmr, &kp, &kp, KEYS_L THUMBS) // Right-hand HRMs.

// Hack: Make HRM combos tap-only (cf, ZMK issue #544).
#define ZMK_COMBO_8(NAME, TAP, POS, LAYERS, COMBO_MS, IDLE_MS, HOLD, SIDE)     \
  MAKE_HRM(hm_combo_##NAME, &kp, TAP, SIDE THUMBS)                             \
  ZMK_COMBO_6(NAME, &hm_combo_##NAME HOLD 0, POS, LAYERS, COMBO_MS, IDLE_MS)

/* Combos, leader key sequences, mouse emulation */

#include "macros.dtsi"
#include "combos.dtsi" // Must be sourced after HRM-combo hack.
#include "mouse.dtsi"

/* Nav cluster */

// Trigger tap-action on all interrupts.
#define MT_CORE                                                                \
  flavor = "tap-preferred";                                                    \
  tapping-term-ms = <220>;                                                     \
  quick-tap-ms = <220>;                                                        \
  hold-trigger-key-positions = <0>;

&mt { MT_CORE };

ZMK_HOLD_TAP(mt_home, bindings = <&masked_home>, <&kp>; MT_CORE)
ZMK_HOLD_TAP(mt_end, bindings = <&masked_end>, <&kp>; MT_CORE)

#define NAV_LEFT  &mt_home 0   LEFT  // Tap: left  | Long-tap: start of line.
#define NAV_RIGHT &mt_end 0    RIGHT // Tap: right | Long-tap: end   of line.
#define NAV_UP    &mt LC(HOME) UP    // Tap: up    | Long-tap: start of doc.
#define NAV_DOWN  &mt LC(END)  DOWN  // Tap: down  | Long-tap: end   of doc.
#define NAV_BSPC  &mt LC(BSPC) BSPC  // Tap: bspc  | Long-tap: delete word bwd.
#define NAV_DEL   &mt LC(DEL)  DEL   // Tap: del   | Long-tap: delete word fwd.

// Mask CTRL on left/right hold to avoid accidental jumps to start/end of doc.
#define MASK_MODS(NAME, MODS, BINDING)                                         \
  ZMK_MOD_MORPH(NAME, bindings = <BINDING>, <BINDING>; mods = <MODS>;)

MASK_MODS(masked_home, (MOD_LCTL), &kp HOME)
MASK_MODS(masked_end,  (MOD_LCTL), &kp END)

ZMK_HOLD_TAP(shft_space, bindings = <&kp>, <&kp>; MT_CORE)

// Tap: backspace | double-tap: delete word | Hold: window layer.
#define SMART_WINDOW &smart_window WIN 0
ZMK_HOLD_TAP(smart_window, bindings = <&mo>, <&bsp_dance>; flavor = "balanced";
             tapping-term-ms = <200>; quick-tap-ms = <QUICK_TAP_MS>;)
ZMK_TAP_DANCE(bsp_dance, bindings = <&kp BACKSPACE>, <&kp LC(BSPC)>;
              tapping-term-ms = <200>;)

// Tap: repeat after alpha, else sticky-shift |
// Shift + tap/ double-tap: caps-word | Hold: shift.
#define MAGIC_SHIFT &magic_shift LSHFT 0
ZMK_HOLD_TAP(magic_shift, bindings = <&kp>, <&magic_shift_tap>;
             flavor = "balanced"; tapping-term-ms = <200>;
             quick-tap-ms = <QUICK_TAP_MS>;)
ZMK_MOD_MORPH(magic_shift_tap, bindings = <&shift_repeat>, <&caps_word>;
              mods = <(MOD_LSFT)>;)
ZMK_ADAPTIVE_KEY(
    shift_repeat, bindings = <&sk LSHFT>;
    repeat {
      trigger-keys = <A B C D E F G H I J K L M N O P Q R S T U V W X Y Z>;
      bindings = <&key_repeat>;
      max-prior-idle-ms = <1200>;
      strict-modifiers;
    };)
&caps_word { // Mods deactivate caps-word, requires PR #1451. [TODO: rebase]
  /delete-property/ ignore-modifiers;
};

ZMK_LAYER(Base, 
&kp B       &kp F       &kp L       &kp K       &kp Q           &kp P       &kp G       &kp O       &kp U       &kp DOT
&kp ESC   &hml LGUI N &hml LALT S &hml LSHFT H &hml LCTRL T &kp M       &kp Y    &hmr RCTRL C &hmr RSHFT A &hmr RALT E &hmr RGUI I &kp BACKSPACE
&kp LC(LALT) &kp X     &kp V       &kp J        &kp D      &kp Z &kp K_MUTE &kp K_MUTE &kp SQT &kp W &kp KP_MINUS &kp SLASH &kp COMMA &kp INS
&kp LCTRL &shft_space LSHFT R &lt NAV SPACE &lt FUN RET &lt NUM TAB SMART_WINDOW MAGIC_SHIFT &lt MOU DEL,
&inc_dec_kp LC(Y) LC(Z) &inc_dec_kp PG_DN PG_UP
)

ZMK_LAYER(Qwerty, 
&kp Q       &kp W       &kp E       &kp R       &kp T      &kp Y     &kp U       &kp I       &kp O       &kp P       
&kp ESC   &hml LGUI A &hml LALT S &hml LSHFT D &hml LCTRL F &kp G       &kp H    &hmr RCTRL J &hmr RSHFT K &hmr RALT L &hmr RGUI SEMI &kp BACKSPACE
&kp LC(LALT) &kp Z     &kp X       &kp C        &kp V      &kp B &kp K_MUTE &kp K_MUTE &kp N &kp M &kp COMMA &kp DOT &kp SLASH &kp INS
&kp LCTRL &shft_space LSHFT SPACE &lt NAV SPC  &lt FUN RET &lt NUM TAB &lt WIN BACKSPACE MAGIC_SHIFT &lt MOU DEL,
&inc_dec_kp LC(Y) LC(Z) &inc_dec_kp PG_DN PG_UP
)

ZMK_LAYER(Nav,
___ ___ ___ ___ ___     XXX &kp HOME &kp TAB &kp END XXX
___ ___ ___ ___ ___ ___ NAV_LEFT      NAV_DOWN  NAV_UP     NAV_RIGHT &kp PSCRN ___
___ ___ ___ ___ ___ ___ ___ ___ XXX XXX XXX XXX XXX ___
___ ___ ___ ___ ___ ___ ___ ___,
&inc_dec_kp TAB LS(TAB) &inc_dec_kp PG_DN PG_UP
)

ZMK_LAYER(Num,
&kp EQUAL &kp N7 &kp N8 &kp N9 &kp KP_PLUS ___ ___ ___ ___ ___
___ &kp N0 &kp N4 &kp N5 &kp N6 &kp DOT ___ ___ ___ ___ ___ ___
___ ___ &kp N1 &kp N2 &kp N3 &kp MINUS ___ ___ ___ ___ ___ ___ ___ ___
___ ___ ___ ___ ___ ___ ___ ___,
&inc_dec_kp LC(LS(Z)) LC(Z) &inc_dec_kp PG_DN PG_UP
)

ZMK_LAYER(Win,
&kp LG(LS(N1)) &kp LG(LS(N2)) &kp LG(LS(N3)) &kp LG(LS(N4)) &kp LG(LS(N5)) &kp LG(LS(N6)) &kp LG(LS(N7)) &kp LG(LS(N8)) &kp LG(LS(N9)) &kp LG(LS(N0))
___ &kp LG(N1) &kp LG(N2) &kp LG(N3) &kp LG(N4) &kp LG(N5) &kp LG(N6) &kp LG(N7) &kp LG(N8) &kp LG(N9) &kp LG(N0) ___
___ ___ ___ ___ ___ ___ ___ ___ ___ ___ ___ ___ ___ ___
___ ___ ___ ___ ___ ___ ___ ___,
&inc_dec_kp LC(Y) LC(Z) &inc_dec_kp PG_DN PG_UP
)

ZMK_LAYER(Fun,
&kp F11 &kp F12 XXX XXX &tog QWE _BT_SEL_KEYS_
&bootloader &kp F1 &kp F2 &kp F3 &kp F4 &kp F5 XXX ___ ___ ___ ___ &bootloader
&sys_reset &kp F6 &kp F7 &kp F8 &kp F9 &kp F10 XXX ___ ___ XXX XXX XXX XXX &sys_reset
___ ___ ___ ___ ___ ___ ___ ___,
&inc_dec_kp LC(Y) LC(Z) &inc_dec_kp PG_DN PG_UP
)

ZMK_LAYER(Mou,
___ ___ ___ ___ ___ XXX U_WH_U XXX U_WH_D XXX
___ XXX &kp C_PREV &kp C_NEXT &kp C_PP XXX XXX U_MS_L U_MS_D U_MS_U U_MS_R ___
___ ___ ___ ___ ___ ___ &kp K_MUTE &kp K_MUTE XXX &mkp LCLK     &mkp MCLK      &mkp RCLK XXX ___
___ ___ ___ ___ ___ ___ ___ ___,
&inc_dec_kp C_VOL_UP C_VOL_DN &inc_dec_kp C_VOL_UP C_VOL_DN
)